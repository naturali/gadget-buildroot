## gadget/package/python-gattlib/Config.in
```kconfig
config BR2_PACKAGE_PYTHON_GATTLIB
	bool "python-gattlib"
	select BR2_PACKAGE_BOOST_PYTHON
	select BR2_PACKAGE_BOOST_THREAD
	help
	  Library to access Bluetooth LE devices.

	  https://bitbucket.org/OscarAcena/pygattlib
```

## gadget/package/python-pybluez/Config.in
```kconfig
config BR2_PACKAGE_PYTHON_PYBLUEZ
	bool "python-pybluez"
	select BR2_PACKAGE_BLUEZ5_UTILS
	help
	  Bluetooth Python extension module.

	  http://karulis.github.io/pybluez/
```
